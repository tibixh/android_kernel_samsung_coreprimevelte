&gen_panel {
	dsi_sc7798d_cpt_WVGA: gen-panel-sc7798d-cpt-coreprimevelte-WVGA-video {
		gen-panel-manu = "DCT";		/* condensed manufacturer name */
		gen-panel-name = "sc7798d-cpt";
		gen-panel-id = <0x5540f0>;
		gen-panel-type = "video_mode";
		gen-panel-refresh = <60>;
		gen-panel-xres = <480>;
		gen-panel-yres = <800>;
		gen-panel-width= <60>;			/* screen width in mm */
		gen-panel-height = <100>;		/* screen height in mm */
		gen-panel-h-front-porch = <140>;	/* right margin */
		gen-panel-h-back-porch = <132>;		/* left margin */
		gen-panel-h-sync-width = <4>;		/* hsync len */
		gen-panel-v-front-porch = <10>;		/* lower margin */
		gen-panel-v-back-porch = <12>;		/* upper margin */
		gen-panel-v-sync-width = <4>;		/* vsync len */
		gen-panel-hsync-invert = <0>;		/* hsync invert */
		gen-panel-vsync-invert = <0>;		/* vsync invert */
		gen-panel-lanes = <2>;
		gen-panel-burst-mode = <2>;
		gen-panel-master-mode;
		/* gen-panel-hfp-en; */
		gen-panel-hbp-en;
		/* gen-panel-adaptive-fps-en; */
		gen-panel-adaptive-fps-en;
		gen-panel-switch-fps = <50>;		/* switching fps */
		gen-panel-default-fps = <60>;		/* default fps */
		gen-panel-flipcnt-wait = <1000>;	/* fps checking time */

		/*
		 * DSI PACKET HEADER INFO
		 * @ data type : 1byte
		 * @ tx mode : 1byte
		 * @ delay(msec) : 2byte
		 * @ size of data : 2byte
		 */
		gen-panel-pkt-dinfo-addr-offset = <0>;
		gen-panel-pkt-dinfo-addr-length = <1>;
		gen-panel-pkt-dinfo-data-offset = <1>;
		gen-panel-pkt-dinfo-data-length = <1>;
		gen-panel-init-cmds = [
			39 00 00 00 00 04	B9 F1 08 00
			15 00 00 00 00 02	BC 67
			39 00 00 00 00 13	BA 31 00 44 25 91 0A 00 00 C2 34 00 00 04 02 4F
								B9 EE 40
			15 00 00 00 00 02	B2 03
			15 00 00 00 00 02	B4 00
			39 00 00 00 00 08	B1 22 1B 1B B7 22 04 A8
			39 00 00 00 00 04	C6 00 00 F7
			15 00 00 00 00 02	CC 0E
			39 00 00 00 00 05	E3 02 02 02 02
			39 00 00 0A 00 03	B8 06 22
			39 00 00 0A 00 03	B5 0F 0F
			39 00 00 00 00 06	C0 73 50 00 08 70
			39 00 00 00 00 09	B3 01 00 06 06 0A 0A 45 40
			39 00 00 00 00 04	B9 F1 08 00
			39 00 00 00 00 34	E9 00 00 08 03 2F 69 6A 12 31 23 48 0D 69 6A 37
								02 04 00 00 00 00 20 88 88 40 28 69 48 88 88 80
								88 88 51 38 79 58 88 88 81 00 00 00 00 00 00 00
								00 00 00 00
			39 00 00 00 00 25	EA 88 88 37 59 18 18 88 88 85 88 88 26 49 08 08
								88 88 84 30 00 00 FF 00 50 00 00 00 00 00 00 00
								00 00 00 00 00
			39 00 00 00 00 23	E0 00 0A 10 37 3C 38 23 46 05 0C 14 12 14 13 14
								0A 1B 00 0A 10 36 3C 3E 23 4A 05 0C 0F 13 15 14
								14 0A 1F
			39 00 00 00 00 80	C1 01 00 0E 14 19 1C 24 2D 35 3C 43 4A 52 5A 61
								69 70 76 7D 85 8E 96 A0 A9 B3 B9 C0 C8 CF D7 E2
								E9 F3 FF 00 00 00 00 00 00 00 00 03 00 0E 14 19
								1C 25 2E 36 3D 44 4B 53 5B 62 6A 70 77 7E 86 8F
								97 A1 AA B4 BA C1 C9 D0 D8 E2 EA F4 FF 00 00 00
								00 00 00 00 00 03 00 0D 13 19 1C 25 2E 36 3E 44
								4B 52 5A 61 69 70 77 7E 86 8F 97 A1 AA B4 BA C1
								C9 D0 D9 E3 EB F3 FF 00 00 00 00 00 00 00 00 03
		];
		gen-panel-enable-cmds = [
			05 00 00 79 00 01	11
			05 00 00 0A 00 01	29
		];
		gen-panel-disable-cmds = [
			05 00 00 0A 00 01	28
			05 00 00 79 00 01	10
		];
		/*
		 * mDNIe
		 */
		gen-panel-mdnie-ui-mode-cmds = [
			39 00 00 00 00 71	E6 5A 00 00 23 00 00 00 00 00 00 00 00 00 00 00
								00 00 00 00 00 00 00 FF 00 FF 00 FF FF 00 00 FF
								00 FF 00 FF FF 00 00 FF 00 FF 00 FF FF 00 02 ff
								00 20 00 20 00 20 00 20 00 20 00 20 00 20 00 20
								00 20 00 20 00 20 00 20 00 20 00 20 00 20 00 20
								00 20 00 20 00 20 00 20 00 20 00 20 00 20 00 04
								b5 1f 88 1f c3 1f e9 04 54 1f c3 1f e9 1f 88 04
								8f
		];
		gen-panel-mdnie-video-mode-cmds = [
			39 00 00 00 00 71	E6 5A 00 00 23 00 00 00 00 00 00 00 00 00 00 00
								00 00 00 00 00 00 00 FF 00 FF 00 FF FF 00 00 FF
								00 FF 00 FF FF 00 00 FF 00 FF 00 FF FF 00 03 ff
								00 08 bf 20 0f a6 16 a6 16 a6 16 a6 16 a6 16 a0
								0a a0 0a a0 0a a0 0a 9e 07 9e 07 9e 07 9e 07 9a
								03 9a 03 9a 03 9a 03 14 00 14 00 14 00 14 00 04
								b5 1f 88 1f c3 1f e9 04 54 1f c3 1f e9 1f 88 04
								8f
		];
		gen-panel-mdnie-camera-mode-cmds = [
			39 00 00 00 00 71	E6 5A 00 00 23 00 00 00 00 00 00 00 00 00 00 00
								00 00 00 00 00 00 00 FF 00 FF 00 FF FF 00 00 FF
								00 FF 00 FF FF 00 00 FF 00 FF 00 FF FF 00 02 ff
								00 20 00 20 00 20 00 20 00 20 00 20 00 20 00 20
								00 20 00 20 00 20 00 20 00 20 00 20 00 20 00 20
								00 20 00 20 00 20 00 20 00 20 00 20 00 20 00 04
								b5 1f 88 1f c3 1f e9 04 54 1f c3 1f e9 1f 88 04
								8f
		];
		gen-panel-mdnie-gallery-mode-cmds = [
			39 00 00 00 00 71	E6 5A 00 00 23 00 00 00 00 00 00 00 00 00 00 00
								00 00 00 00 00 00 00 FF 00 FF 00 FF FF 00 00 FF
								00 FF 00 FF FF 00 00 FF 00 FF 00 FF FF 00 02 ff
								00 20 00 20 00 20 00 20 00 20 00 20 00 20 00 20
								00 20 00 20 00 20 00 20 00 20 00 20 00 20 00 20
								00 20 00 20 00 20 00 20 00 20 00 20 00 20 00 04
								b5 1f 88 1f c3 1f e9 04 54 1f c3 1f e9 1f 88 04
								8f
		];
		gen-panel-mdnie-negative-mode-cmds = [
			39 00 00 00 00 71	E6 5A 00 00 32 00 00 00 00 00 00 00 00 00 00 00
								00 00 00 00 00 00 ff 00 ff 00 ff 00 00 ff ff 00
								ff 00 ff 00 00 ff ff 00 ff 00 ff 00 00 ff 00 ff
								00 20 00 20 00 20 00 20 00 20 00 20 00 20 00 20
								00 20 00 20 00 20 00 20 00 20 00 20 00 20 00 20
								00 20 00 20 00 20 00 20 00 20 00 20 00 20 00 04
								00 00 00 00 00 00 00 04 00 00 00 00 00 00 00 04
								00
		];
		gen-panel-mdnie-vt-mode-cmds = [
			39 00 00 00 00 71	E6 5A 00 00 23 00 00 00 00 00 00 00 00 00 00 00
								00 00 00 00 00 00 00 FF 00 FF 00 FF FF 00 00 FF
								00 FF 00 FF FF 00 00 FF 00 FF 00 FF FF 00 02 ff
								00 20 00 20 00 20 00 20 00 20 00 20 00 20 00 20
								00 20 00 20 00 20 00 20 00 20 00 20 00 20 00 20
								00 20 00 20 00 20 00 20 00 20 00 20 00 20 00 04
								b5 1f 88 1f c3 1f e9 04 54 1f c3 1f e9 1f 88 04
								8f
		];
		gen-panel-mdnie-browser-mode-cmds = [
			39 00 00 00 00 71	E6 5A 00 00 23 00 00 00 00 00 00 00 00 00 00 00
								00 00 00 00 00 00 00 FF 00 FF 00 FF FF 00 00 FF
								00 FF 00 FF FF 00 00 FF 00 FF 00 FF FF 00 02 ff
								00 20 00 20 00 20 00 20 00 20 00 20 00 20 00 20
								00 20 00 20 00 20 00 20 00 20 00 20 00 20 00 20
								00 20 00 20 00 20 00 20 00 20 00 20 00 20 00 04
								b5 1f 88 1f c3 1f e9 04 54 1f c3 1f e9 1f 88 04
								8f
		];
		gen-panel-mdnie-ebook-mode-cmds = [
			39 00 00 00 00 71	E6 5A 00 00 33 00 00 00 00 00 00 00 00 00 00 00
								00 00 00 00 00 00 00 d6 00 f5 00 ff FF 00 00 FF
								00 FF 00 FF FF 00 00 FF 00 FF 00 FF FF 00 02 ff
								00 20 00 20 00 20 00 20 00 20 00 20 00 20 00 20
								00 20 00 20 00 20 00 20 00 20 00 20 00 20 00 20
								00 20 00 20 00 20 00 20 00 20 00 20 00 20 00 04
								b5 1f 88 1f c3 1f e9 04 54 1f c3 1f e9 1f 88 04
								8f
		];
		gen-panel-mdnie-email-mode-cmds = [
			39 00 00 00 00 71	E6 5A 00 00 33 00 00 00 00 00 00 00 00 00 00 00
								00 00 00 00 00 00 00 de 00 f1 00 ff FF 00 00 FF
								00 FF 00 FF FF 00 00 FF 00 FF 00 FF FF 00 02 ff
								00 20 00 20 00 20 00 20 00 20 00 20 00 20 00 20
								00 20 00 20 00 20 00 20 00 20 00 20 00 20 00 20
								00 20 00 20 00 20 00 20 00 20 00 20 00 20 00 04
								b5 1f 88 1f c3 1f e9 04 54 1f c3 1f e9 1f 88 04
								8f
		];
		gen-panel-mdnie-outdoor-mode-cmds = [
			39 00 00 00 00 71	E6 5A 00 00 33 00 00 00 00 00 00 00 00 00 00 00
								00 00 00 00 00 00 00 FF 00 FF 00 FF FF 00 00 FF
								00 FF 00 FF FF 00 00 FF 00 FF 00 FF FF 00 03 ff
								00 17 48 18 40 1a 33 1b 2e 1e 23 22 19 22 19 22
								19 22 19 22 19 22 19 28 10 28 10 28 10 28 10 28
								10 32 08 32 08 32 08 32 08 32 08 48 03 7b 00 04
								b5 1f 88 1f c3 1f e9 04 54 1f c3 1f e9 1f 88 04
								8f
		];
		gen-panel-read-id = [
			DA 00 01
			DB 00 01
			DC 00 01
		];
		gen-panel-read-status-reg = [0A];
		gen-panel-read-status-ok = [9A];
		status = "okay";
	};
};
